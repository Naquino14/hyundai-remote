## boards/heltec/heltec_htit_tracker/Kconfig.heltec_htit_tracker
```kconfig
# HELTEC ESP32 board configuration

# Copyright (c) 2025 Nate Aquino
# SPDX-License-Identifier: Apache-2.0

config BOARD_HELTEC_HTIT_TRACKER
	select SOC_ESP32S3_FN8
	select SOC_ESP32S3_PROCPU if BOARD_HELTEC_HTIT_TRACKER_ESP32_PROCPU
	select SOC_ESP32S3_APPCPU if BOARD_HELTEC_HTIT_TRACKER_ESP32_APPCPU
```

## boards/heltec/heltec_htit_tracker/board.yml
```yaml
board:
  name: heltec_htit_tracker
  full_name: Heltec WiFi HTIT Tracker
  vendor: heltec
  socs:
    - name: esp32s3
```

## boards/heltec/heltec_htit_tracker/heltec_htit_tracker_procpu_defconfig
```kconfig
# SPDX-License-Identifier: Apache-2.0

CONFIG_MAIN_STACK_SIZE=2048

CONFIG_USB_DEVICE_STACK=y
CONFIG_USB_CDC_ACM=y
CONFIG_USB_DEVICE_PRODUCT="HTIT Tracker"
CONFIG_USB_DEVICE_INITIALIZE_AT_BOOT=y
CONFIG_USB_DEVICE_VID=0xfefe
CONFIG_USB_DEVICE_PID=0xadad

CONFIG_GPIO=y
CONFIG_PWM=y
```

## boards/heltec/heltec_wifi_lora32_v3/Kconfig.heltec_wifi_lora32_v3
```kconfig
# HELTEC ESP32 board configuration

# Copyright (c) 2025 Nate Aquino
# SPDX-License-Identifier: Apache-2.0

config BOARD_HELTEC_WIFI_LORA32_V3
	select SOC_ESP32_D0WD_V3
	select SOC_ESP32S3_PROCPU if BOARD_HELTEC_WIFI_LORA32_V3_ESP32_PROCPU
	select SOC_ESP32S3_APPCPU if BOARD_HELTEC_WIFI_LORA32_V3_ESP32_APPCPU
```

## boards/heltec/heltec_wifi_lora32_v3/heltec_wifi_lora32_v3_appcpu_defconfig
```kconfig
# SPDX-License-Identifier: Apache-2.0

CONFIG_HELTEC_WIFI_LORA32=y

CONFIG_MAIN_STACK_SIZE=2048
CONFIG_CLOCK_CONTROL=y
```

## boards/heltec/heltec_wifi_lora32_v3/heltec_wifi_lora32_v3_procpu_defconfig
```kconfig
# SPDX-License-Identifier: Apache-2.0

CONFIG_MAIN_STACK_SIZE=2048

CONFIG_CONSOLE=y
CONFIG_SERIAL=y
CONFIG_UART_CONSOLE=y

CONFIG_GPIO=y
CONFIG_PWM=y

CONFIG_SSD1306=y
CONFIG_SSD1306_DEFAULT_CONTRAST=128

# LVGL Configuration
CONFIG_LV_COLOR_DEPTH_1=y
CONFIG_LV_Z_FULL_REFRESH=y
```
